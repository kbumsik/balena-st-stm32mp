## layers/meta-balena-st-stm32mp/conf/layer.conf
```bitbake
BBPATH .= ":${LAYERDIR}"

BBFILES += "${LAYERDIR}/recipes-*/*/*.bb \
            ${LAYERDIR}/recipes-*/*/*.bbappend"

BBFILE_COLLECTIONS += "balena_st_stm32mp"
BBFILE_PATTERN_balena_st_stm32mp := "^${LAYERDIR}/"
BBFILE_PRIORITY_balena_st_stm32mp = "1337"

LAYERSERIES_COMPAT_balena_st_stm32mp = "thud"

# ENABLE_PARTITIONS_IMAGE is used in st-partitions-image.bbclass
# There are partition configuration conflicts with st-partitions-image.
# So disable it entirely then use st-partitions-image in resin-st-image instead.
ENABLE_PARTITIONS_IMAGE = "0"
# ENABLE_FLASHLAYOUT_CONFIG is used in flashlayout-stm32mp.bbclass.
# Disabled for the same reason as above.
ENABLE_FLASHLAYOUT_CONFIG = "0"
```
